## buildroot-external/Config.in
```kconfig
menu "Driver lab packages"
	source "$BR2_EXTERNAL_DRIVERLAB_PATH/package/drv-pci/Config.in"
	source "$BR2_EXTERNAL_DRIVERLAB_PATH/package/pci-dma-tool/Config.in"
	source "$BR2_EXTERNAL_DRIVERLAB_PATH/package/driverlab-tests/Config.in"
endmenu
```

## buildroot-external/configs/driverlab_x86_64_defconfig
```kconfig
# Based on Buildroot's qemu_x86_64_defconfig
BR2_x86_64=y
BR2_PACKAGE_HOST_LINUX_HEADERS_CUSTOM_6_18=y
BR2_GLOBAL_PATCH_DIR="board/qemu/patches"
BR2_DOWNLOAD_FORCE_CHECK_HASHES=y
BR2_CCACHE=y
BR2_TARGET_GENERIC_HOSTNAME="driverlab"
BR2_TARGET_GENERIC_ISSUE="Driver lab (x86_64) - login as root, no password"
BR2_SYSTEM_DHCP="eth0"
BR2_ROOTFS_OVERLAY="$(BR2_EXTERNAL_DRIVERLAB_PATH)/overlay"

# Kernel
BR2_LINUX_KERNEL=y
BR2_LINUX_KERNEL_CUSTOM_VERSION=y
BR2_LINUX_KERNEL_CUSTOM_VERSION_VALUE="6.18.7"
BR2_LINUX_KERNEL_USE_CUSTOM_CONFIG=y
BR2_LINUX_KERNEL_CUSTOM_CONFIG_FILE="board/qemu/x86_64/linux.config"
BR2_LINUX_KERNEL_CONFIG_FRAGMENT_FILES="$(BR2_EXTERNAL_DRIVERLAB_PATH)/board/x86_64/linux-extra.config"
BR2_LINUX_KERNEL_NEEDS_HOST_LIBELF=y

# Root filesystem
BR2_TARGET_ROOTFS_EXT2=y
BR2_TARGET_ROOTFS_EXT2_4=y
# BR2_TARGET_ROOTFS_TAR is not set

# Tools in the guest
BR2_PACKAGE_PCIUTILS=y

# Our drivers and test programs
BR2_PACKAGE_DRV_PCI=y
BR2_PACKAGE_PCI_DMA_TOOL=y
BR2_PACKAGE_DRIVERLAB_TESTS=y
```

## buildroot-external/package/driverlab-tests/Config.in
```kconfig
config BR2_PACKAGE_DRIVERLAB_TESTS
	bool "driverlab-tests"
	help
	  Guest-side driver tests, run by scripts/test.sh on the host
	  (or manually with "driverlab-test" in the guest).
```

## buildroot-external/package/drv-pci/Config.in
```kconfig
config BR2_PACKAGE_DRV_PCI
	bool "drv-pci"
	depends on BR2_LINUX_KERNEL
	help
	  Linux driver for custom-pci-device (QEMU): BAR0 MMIO,
	  DMA and MSI, exposed to userspace as /dev/drv_pci.

comment "drv-pci needs a Linux kernel to be built"
	depends on !BR2_LINUX_KERNEL
```

## buildroot-external/package/pci-dma-tool/Config.in
```kconfig
config BR2_PACKAGE_PCI_DMA_TOOL
	bool "pci-dma-tool"
	help
	  Userspace tool for drv_pci: zero-copy loopback with mmap and
	  ioctl, argument checks and a small benchmark.
```
